## apps/android/runtime/buildroot-external/Config.in
```kconfig
source "$BR2_EXTERNAL_GALAXYSSI_PATH/package/galaxyssi-runtime-launcher/Config.in"
```

## apps/android/runtime/buildroot-external/package/galaxyssi-runtime-launcher/Config.in
```kconfig
config BR2_PACKAGE_GALAXYSSI_RUNTIME_LAUNCHER
	bool "galaxyssi-runtime-launcher"
	help
	  Installs the privileged launcher that creates an isolated namespace,
	  applies resource limits, drops privileges, and starts one Agent task.
```
